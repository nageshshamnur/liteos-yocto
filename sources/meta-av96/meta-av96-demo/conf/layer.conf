## sources/meta-av96/meta-av96-demo/conf/layer.conf
```bitbake
# We have a conf and classes directory, add to BBPATH
BBPATH .= ":${LAYERDIR}"

# We have recipes-* directories, add to BBFILES
BBFILES += "${LAYERDIR}/recipes-*/*/*.bb \
            ${LAYERDIR}/recipes-*/*/*.bbappend"

BBFILE_COLLECTIONS += "meta-av96-demo"
BBFILE_PATTERN_meta-av96-demo = "^${LAYERDIR}/"
BBFILE_PRIORITY_meta-av96-demo = "6"

LAYERDEPENDS_meta-av96-demo = "core meta-av96-core qt5-layer"
LAYERSERIES_COMPAT_meta-av96-demo = "dunfell"
```

## sources/meta-liteosm/conf/distro/liteosm.conf
```bitbake
DISTRO = "liteosm"
DISTRO_NAME = "liteosm"
DISTRO_VERSION = "1.0"

TARGET_VENDOR = "-yocto"

TCLIBC = "newlib"

#INHERIT += "siteinfo-zephyr"

INHERIT += "uninative"
require conf/distro/include/yocto-uninative.inc
```

## sources/meta-liteosm/conf/layer.conf
```bitbake
# We have a conf and classes directory, add to BBPATH
BBPATH .= ":${LAYERDIR}"

# We have recipes-* directories, add to BBFILES
BBFILES += "${LAYERDIR}/recipes-*/*/*.bb \
	${LAYERDIR}/recipes-*/*/*.bbappend"

BBFILE_COLLECTIONS += "liteosm"
BBFILE_PATTERN_liteosm = "^${LAYERDIR}/"
BBFILE_PRIORITY_liteosm = "6"

# This should only be incremented on significant changes that will
# cause compatibility issues with other layers
LAYERVERSION_liteosm = "1"

LAYERDEPENDS_liteosm = "core meta-python"

LAYERSERIES_COMPAT_liteosm = "dunfell gatesgarth hardknott"
```

## sources/meta-liteosm/conf/machine/include/qemuriscv32nf.inc
```bitbake
require conf/machine/include/riscv/tune-riscv.inc
require conf/machine/include/riscv/qemuboot-riscv32.inc

IMAGE_PKGTYPE = "rpm"

#LITEOSM_CLASS_INCLUDE = "core-image liteosm-qemuboot"
LITEOSM_CLASS_INCLUDE = "liteosm-qemuboot"
inherit ${LITEOSM_CLASS_INCLUDE}

KERNEL_IMAGETYPE = "${PN}.elf"
QB_DEFAULT_KERNEL = "${PN}.elf"

#MACHINE_FEATURES = "vfat"

MACHINEOVERRIDES =. "qemuall:"


EXTRA_IMAGEDEPENDS += "qemu-system-native qemu-helper-native"

# qemuboot options
QB_SYSTEM_NAME = "qemu-system-riscv32"
QB_MACHINE = "-machine virt"
QB_CPU = "-cpu rv32"
QB_MEM = "-m 128"
QB_KERNEL_CMDLINE_APPEND = "root=dev/vda or console=ttyS0"

SERIAL_CONSOLES ?= "ttyS0"
SERIAL_CONSOLES_CHECK = "${SERIAL_CONSOLES}"
```

## sources/meta-liteosm/conf/machine/qemuriscv32nf.conf
```bitbake
#@TYPE: Machine
#@NAME: generic riscv32 soft-float machine
#@DESCRIPTION: Machine configuration for running a generic riscv32 soft-float OS

IMAGE_PKGTYPE = "rpm"

require include/qemuriscv32nf.inc

DEFAULTTUNE = "riscv32nf"

PREFERRED_VERSION_openocd-native = "riscv"
PREFERRED_VERSION_openocd = "riscv"

XVISOR_PLAT = "riscv/virt32"

EXTRA_IMAGEDEPENDS += "u-boot"
UBOOT_MACHINE = "qemu-riscv32_smode_defconfig"
UBOOT_ELF = "u-boot"

# qemuboot options
#IMAGE_CLASSES += "qemuboot"
#QB_MACHINE = "-machine virt"
#QB_MEM = "-m 128"
#QB_DEFAULT_KERNEL = "bzImage"
#QB_KERNEL_CMDLINE_APPEND = "root=dev/vda or console=ttyS0" 

# Prelink does not yet work
USER_CLASSES_remove = "image-prelink"

TCLIBC = "baremetal"
```

## sources/meta-ohos/meta-ohos-core/conf/distro/allscenarios-liteosm.conf
```bitbake
# SPDX-FileCopyrightText: Huawei Inc.
#
# SPDX-License-Identifier: Apache-2.0

require conf/distro/include/allscenarios.inc
require conf/distro/liteosm.conf

DISTRO = "allscenarios-liteosm"
DISTRO_NAME = "AllScenariOS Base Liteosm Distro"
DISTRO_VERSION = "1.0.0-beta"
```

## sources/meta-python-dunfellplus/conf/layer.conf
```bitbake
# We have a conf and classes directory, add to BBPATH
BBPATH .= ":${LAYERDIR}"

# We have recipes-* directories, add to BBFILES
BBFILES += "${LAYERDIR}/recipes-*/*/*.bb \
            ${LAYERDIR}/recipes-*/*/*.bbappend"

BBFILE_COLLECTIONS += "meta-python-dunfellplus"
BBFILE_PATTERN_meta-python-dunfellplus = "^${LAYERDIR}/"
BBFILE_PRIORITY_meta-python-dunfellplus = "6"

LAYERDEPENDS_meta-python-dunfellplus = "core"
LAYERDEPENDS_meta-python-dunfellplus += "meta-python"

LAYERSERIES_COMPAT_meta-python-dunfellplus = "dunfell"
```

## sources/meta-riscv/conf/machine/qemuriscv32.conf
```bitbake
#@TYPE: Machine
#@NAME: generic riscv32 machine
#@DESCRIPTION: Machine configuration for running a generic riscv32

require conf/machine/include/riscv/qemuriscv.inc

DEFAULTTUNE = "riscv32"

PREFERRED_VERSION_openocd-native = "riscv"
PREFERRED_VERSION_openocd = "riscv"

XVISOR_PLAT = "riscv/virt32"

EXTRA_IMAGEDEPENDS += "u-boot"
UBOOT_MACHINE = "qemu-riscv32_smode_defconfig"
UBOOT_ELF = "u-boot"

# Prelink does not yet work
USER_CLASSES_remove = "image-prelink"

TCLIBC = "baremetal"
```

## sources/meta-riscv/conf/machine/qemuriscv32nf.conf
```bitbake
#@TYPE: Machine
#@NAME: generic riscv32 soft-float machine
#@DESCRIPTION: Machine configuration for running a generic riscv32 soft-float OS

require conf/machine/include/riscv/qemuriscv.inc

DEFAULTTUNE = "riscv32nf"

PREFERRED_VERSION_openocd-native = "riscv"
PREFERRED_VERSION_openocd = "riscv"

XVISOR_PLAT = "riscv/virt32"

EXTRA_IMAGEDEPENDS += "u-boot"
UBOOT_MACHINE = "qemu-riscv32_smode_defconfig"
UBOOT_ELF = "u-boot"

# Prelink does not yet work
USER_CLASSES_remove = "image-prelink"

TCLIBC = "baremetal"
```

## sources/meta-seco-intel/conf/layer.conf
```bitbake
# We have a conf and classes directory, add to BBPATH
BBPATH .= ":${LAYERDIR}"

# We have recipes-* directories, add to BBFILES
BBFILES += "${LAYERDIR}/recipes-*/*/*.bb \
            ${LAYERDIR}/recipes-*/*/*.bbappend"

# This layer only contains machine definitions (as per now), so there are no
# recipes
BBFILE_PATTERN_IGNORE_EMPTY_seco-intel = "1"

BBFILES_DYNAMIC += ""

BBFILE_COLLECTIONS += "seco-intel"
BBFILE_PATTERN_seco-intel := "^${LAYERDIR}/"
BBFILE_PRIORITY_seco-intel = "9"

# This should only be incremented on significant changes that will
# cause compatibility issues with other layers
LAYERVERSION_seco-intel = "1"
LAYERSERIES_COMPAT_seco-intel = "warrior zeus dunfell"
```

## sources/meta-seco-intel/conf/machine/include/meta-seco-intel.inc
```bitbake
PREFERRED_VERSION_linux-intel = "5.10%"
PREFERRED_VERSION_linux-intel-rt = "5.10%"
PREFERRED_VERSION_linux-intel_poky-altcfg = "5.10%"
PREFERRED_VERSION_linux-intel-rt_poky-altcfg = "5.10%"
```

## sources/meta-seco-intel/conf/machine/seco-core2-32.conf
```bitbake
#@TYPE: Machine
#@NAME: seco-core2-32

#@DESCRIPTION: Machine configuration for 32 bit Intel Core 2 CPU (and later) with MMX, SSE, SSE2, SSE3, and SSSE3 instruction set support. Supports a moderately wide range of drivers that should boot and be usable on "typical" hardware.

require conf/machine/intel-core2-32.conf
require conf/machine/include/meta-seco-intel.inc
```

## sources/meta-seco-intel/conf/machine/seco-corei7-64.conf
```bitbake
#@TYPE: Machine
#@NAME: seco-corei7-64

#@DESCRIPTION: Machine configuration for 64 bit Intel Core i7 CPU (and later) with MMX, SSE, SSE2, SSE3, and SSSE3 instruction set support. Supports a moderately wide range of drivers that should boot and be usable on "typical" hardware.

require conf/machine/intel-corei7-64.conf
require conf/machine/include/meta-seco-intel.inc
```

## sources/meta-seco-intel/conf/machine/seco-intel-b68.conf
```bitbake
#@TYPE: Machine
#@NAME: seco-intel-b68

#@DESCRIPTION: Machine configuration for SBC-B68-eNUC, embedded NUC SBC with
#the Intel Atom X Series, Intel Celeron J / N Series and Intel Pentium N Series
#(formerly Apollo Lake) Processors

require conf/machine/intel-corei7-64.conf
require conf/machine/include/meta-seco-intel.inc

MACHINE_FEATURES += "modem"
MACHINE_HWCODECS_remove += "gstreamer1.0-vaapi"
```

## sources/meta-seco-intel/conf/machine/seco-skylake-64.conf
```bitbake
#@TYPE: Machine
#@NAME: seco-skylake-64

#@DESCRIPTION: Machine configuration for 64 bit Intel Skylake CPU (and later) with MMX, SSE, SSE2, SSE3, SSE4.1, SSE4.2, AVX, and AVX2 instruction set support. Supports a moderately wide range of drivers that should boot and be usable on "typical" hardware.

require conf/machine/seco-corei7-64.conf
require conf/machine/include/meta-seco-intel.inc
```

## sources/poky/meta/conf/machine/include/riscv/qemuboot-riscv32.inc
```bitbake
#@TYPE: Machine
#@NAME: QEMU RISCV32 machine
#@DESCRIPTION: Machine configuration for running an RISCV32 system on QEMU

IMAGE_CLASSES += "qemuboot"

KERNEL_IMAGETYPE = "bzImage"
QB_DEFAULT_KERNEL = "bzImage"

SERIAL_CONSOLES ?= "ttyS0"
SERIAL_CONSOLES_CHECK = "${SERIAL_CONSOLES}"

# qemuboot options
IMAGE_CLASSES += "qemuboot"
QB_SYSTEM_NAME = "qemu-system-riscv32"
QB_MACHINE = "-machine virt"
QB_CPU = "-cpu riscv32nf"
QB_MEM = "-m 128"
QB_KERNEL_CMDLINE_APPEND = "root=dev/vda or console=ttyS0"
```
